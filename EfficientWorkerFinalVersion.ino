#include <WiFi.h>
#include <SPIFFS.h>
#include <ESPAsyncWebServer.h>
#include <Adafruit_Fingerprint.h>
#include <stdio.h>
#include <stdlib.h>
#include <sqlite3.h>
#include <SPI.h>
#include <FS.h>
#include <SD.h>
#include <AsyncTCP.h>
#include <TimeLib.h>
#include <time.h>

#define mySerial Serial2
#define diodaZaUlazak 2
#define diodaZaMrezu 4
#define brojKolona 100 // bilo sta ovde, ovo samo onako postavio
#define maxRadnika 100 //isto zavisi od broja ljudi..
#define maxRadnika 128

Adafruit_Fingerprint finger = Adafruit_Fingerprint(&mySerial);
const char* ssid = "jasmin"; //sve je isto, samo se ovo mijenja.
const char* password = "jasmin1593";
uint8_t id;
bool diodaUpaljena = true;
bool posluzioEnroll = false;
int rc;
char sql[1024];
int upisivanje; //JOS JEDAN INDIKATOR AKO SE UPISUJUE ONDA JE 1 A AKO SE NE UPISUJE ONDA JE 0
int prekini_upisivanje = 1; //SLUZI DA BI PREKINULO UPISIVANJE U ODREDJENIM SLUCAJEVIMA 
sqlite3 *db1;
sqlite3_stmt *res;
const char *tail;

AsyncWebServer server(80);
AsyncWebSocket ws("/ws");

String log_info[brojKolona];
String db_row[brojKolona];
double satiPoZadatku = 0;

AsyncWebSocketClient * globalClient = NULL;

const char* data = "Callback function called";

//zipovani html fajlovi:
const uint8_t htmlEnroll[] = { 0x1f,0x8b,0x08,0x00,0x6e,0x6c,0x06,0x5e,0x00,0xff,0x9d,0x54,0x5f,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0x00
};

const uint8_t htmlNajefikasniji[] = { 0x1f,0x8b,0x08,0x00,0xf8,0x28,0x09,0x5e,0x00,0xff,0x95,0x56,0x6d,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0x00
};

const uint8_t htmlForma[] = { 0x1f,0x8b,0x08,0x00,0x3b,0xa9,0x0c,0x5e,0x00,0xff,0xed,0x5a,0x6b,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0x00
};

const uint8_t htmlZapisi[] = { 0x1f,0x8b,0x08,0x00,0x1b,0x2a,0x09,0x5e,0x00,0xff,0x95,0x57,0x6d,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0x00
};

const uint8_t htmlKorisnici[] = { 0x1f,0x8b,0x08,0x00,0x4c,0x2b,0x09,0x5e,0x00,0xff,0x95,0x57,0x6d,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0x00
};

const uint8_t htmlHistorija[] = { 0x1f,0x8b,0x08,0x00,0x7e,0xaa,0x0c,0x5e,0x00,0xff,0x95,0x55,0x61,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0x00
};

//neke varijable za tacno primanje datuma i vremena:

char* ntpServer = "pool.ntp.org";
bool vratiNajefikasnije = false;
const short int gmtOffsetSekunde = 3600; //konfiguracija vremena
const short int pomjeranjeSekunde = 3600; //u zavisnosti od geografskog polozaja

//ne moze svako brisati vremena i zapise, samo onaj ko zna sifru:
String lozinkaPokusaj = "";
String lozinka = "mojalozinka123";

//neke od funkcija cija imena sve govore o njima:
void resetujVremena();
void generirajDatumIVrijeme();
char* stringUpChar(String);
void resetujZapise();
void generirajUpitRadnici();
void generirajUpitZapisi();

//pomocni structovi:
struct Radnik {
    String prezime;
    String ime;
    int id;
    byte aktivnost;
};

struct Datum {
    short int dan;
    short int mjesec;
    unsigned short int godina;
};

struct Vrijeme {
    short int sat;
    short int minuta;
};

Radnik r;
Vrijeme v;
Datum d;

//pomocne varijable:
String formirajDatum(int, int);
bool vratiHistoriju = false;
bool vratiKorisnike = false;
bool vratiZapise = false;
bool obrisiZapise = false;
bool obrisiVremena = false;
struct tm vrijemeDatum; // za dobivanje vremena i datuma.
String sqlQuery = "";
double real = -3.5555;
void formirajSqlHistorija();

void setup()  
{
  Serial.begin(115200);
  char *zErrMsg = 0;

  Serial.println("string od negativnog realnog broja je :");
  Serial.println(String(real));
  
  pinMode(diodaZaUlazak, OUTPUT);

  pinMode(diodaZaMrezu, OUTPUT);
  
  SPI.begin();
  SD.begin();
  sqlite3_initialize();

  if (openDb("/sd/bazaPodataka.db", &db1)) {
    Serial.println("Database opened successfully!");
  }
  sqlite3_close(db1);
  while (!Serial);  // For Yun/Leo/Micro/Zero/...
  delay(100);
  Serial.println("\n\nAdafruit finger detect test");
  finger.begin(57600);
  delay(5);
  if (!finger.verifyPassword()) {
    Serial.println("Did not find fingerprint sensor :(");
    while(1) delay(1);
  } 
  Serial.println("Found fingerprint sensor!");
  
  finger.getTemplateCount();
  if (!SPIFFS.begin()){
    Serial.println("An Error has occurred while mounting SPIFFS");
    return;
  }

  WiFi.mode(WIFI_AP_STA); //za konekciju sa internetom, i za AP mod
  WiFi.begin(ssid, password); //konektuj se na globalnu mrezu.
  
  while(WiFi.status() != WL_CONNECTED) {
    delay(1000);
    Serial.println("Connecting to WiFi..."); //upali diodu ako smo spojeni.
  } //znaci da sam konektovan:

  digitalWrite(diodaZaMrezu, HIGH); 

  //konfiguracija za komunikaciju sa ntp serverom:
  configTime(gmtOffsetSekunde, pomjeranjeSekunde, ntpServer);

  WiFi.softAP("ESPServer", "123456789"); //ovo je za konekciju

  delay(500); // sacekaj SYSTEM_EVENT_AP_START event.

  IPAddress espIP(192, 168, 1, 100); //ovo je nasa ip adresa...
  IPAddress gateway(192, 168, 1, 60); //neki bezveze.
  IPAddress subnet(255, 255, 255, 0);

  WiFi.softAPConfig(espIP, gateway, subnet);
  
  IPAddress IP = WiFi.softAPIP();
  
  Serial.println("Ovo je moja Access Point adresa:");
  Serial.println(IP); //trebala bi biti espIP.

  ws.onEvent(onWsEvent);
  server.addHandler(&ws);
  //dodani fajlovi:
  server.on("/forms", HTTP_GET, [](AsyncWebServerRequest *request){
    AsyncWebServerResponse *response = request->beginResponse_P(200, "text/html", htmlForma, sizeof(htmlForma));
    response->addHeader("Content-Encoding", "gzip");
    request->send(response);
  });

  server.on("/zapisi", HTTP_GET, [](AsyncWebServerRequest *request){
    AsyncWebServerResponse *response = request->beginResponse_P(200, "text/html", htmlZapisi, sizeof(htmlZapisi));
    response->addHeader("Content-Encoding", "gzip");
    request->send(response);
  });

  server.on("/korisnici", HTTP_GET, [](AsyncWebServerRequest * request) {
    AsyncWebServerResponse *response = request->beginResponse_P(200, "text/html", htmlKorisnici, sizeof(htmlKorisnici));  
    response->addHeader("Content-Encoding", "gzip");
    request->send(response);
    });

  server.on("/Najefikasniji", HTTP_GET, [](AsyncWebServerRequest * request) { //ovo je html.
    AsyncWebServerResponse *response = request->beginResponse_P(200, "text/html", htmlNajefikasniji, sizeof(htmlNajefikasniji));  
    response->addHeader("Content-Encoding", "gzip");
    request->send(response);  
  });

  server.on("/historijaEfikasnosti", HTTP_GET, [](AsyncWebServerRequest * request) { //ovo je html.
    AsyncWebServerResponse *response = request->beginResponse_P(200, "text/html", htmlHistorija, sizeof(htmlHistorija));  
    response->addHeader("Content-Encoding", "gzip");
    request->send(response);  
  });

  server.on("/efficiencyHistory", HTTP_GET, [](AsyncWebServerRequest * request) {   //ovo je forma.    
    if (request->getParam("id")->value() == "") 
        r.id = -1;
    else
        r.id = (request->getParam("id")->value()).toInt();
    r.ime = request->getParam("ime")->value();    
    r.prezime = request->getParam("prezime")->value();
    d.mjesec = (request->getParam("mjesec")->value()).toInt();
    d.godina = (request->getParam("godina")->value()).toInt();

    //nista.
    
    vratiHistoriju = true;
    request->redirect("/historijaEfikasnosti");
  });

  server.on("/vratiEfikasne", HTTP_GET, [](AsyncWebServerRequest * request) {   //ovo je forma.
    satiPoZadatku = (request->getParam("efikasnost")->value()).toDouble();
    if (satiPoZadatku == 0.000)
        satiPoZadatku = 100000000.00; //uvijek zadovoljeno.
    if (request->getParam("id")->value() == "") 
        r.id = -1;
    else
        r.id = (request->getParam("id")->value()).toInt();
    r.ime = request->getParam("ime")->value();    
    r.prezime = request->getParam("prezime")->value();

    generirajDatumIVrijeme(); //jer trazim iz zadnjeg mjeseca trenutne godine.
    
    vratiNajefikasnije = true;
    request->redirect("/Najefikasniji");
  });

  server.on("/resetujVremena", HTTP_GET, [](AsyncWebServerRequest * request) {
    lozinkaPokusaj = String(request->getParam("sifraa")->value());
    if (lozinkaPokusaj == lozinka) {
      //resetiraj        
      obrisiVremena = true;
      vratiKorisnike = false;
      Serial.println("uspjesno resetiranje korisnickih vremena!");
      request->redirect("/korisnici");
    } else {
      //nemoj resetirati, sifra nije tacna
      obrisiVremena = false;
      vratiKorisnike = false;
      Serial.println("niste unijeli ispravnu lozinku za resetiranje vremena!");
      request->send(404, "text/plain", "Pogresna lozinka za resetiranje vremena korisnika!");
    }
  });

  server.on("/upitZaKorisnike", HTTP_GET, [](AsyncWebServerRequest * request) {
    if (request->getParam("idKorisnik")->value() == "")
        r.id = -1;
    else
        r.id = (request->getParam("idKorisnik")->value()).toInt();

    r.prezime = String(request->getParam("prezimeKorisnika")->value());    
    r.ime = String(request->getParam("imeKorisnika")->value());    

    r.prezime.toLowerCase();
    r.ime.toLowerCase();
    
    vratiKorisnike = true;
    obrisiVremena  = false;
    
    request->redirect("/korisnici");
  });
    
  server.on("/upitBaziPodataka", HTTP_GET, [](AsyncWebServerRequest *request){
    if (request->getParam("ID")->value() == "")
        r.id = -1;
    else
        r.id = (request->getParam("ID")->value()).toInt();    
    r.prezime = String(request->getParam("prezime")->value());
    r.ime = String(request->getParam("ime")->value());
    d.dan = (request->getParam("dan")->value()).toInt();
    d.mjesec = (request->getParam("mjesec")->value()).toInt();
    d.godina = (request->getParam("godina")->value()).toInt();

    r.prezime.toLowerCase();
    r.ime.toLowerCase();
    
    obrisiZapise = false;
    vratiZapise = true;

    request->redirect("/zapisi");                    
  });

  server.on("/zahtjevZaResetiranje", HTTP_GET, [](AsyncWebServerRequest *request){  
    lozinkaPokusaj = String(request->getParam("sifra")->value());

    if (lozinkaPokusaj == lozinka) { // moze biti i druga lozinka, ne mora biti kao u korisnici.
        Serial.println("uspjesno resetovanje zapisa!");

        obrisiZapise = true;
        vratiZapise = false;
        request->redirect("/zapisi");
    } else {
        Serial.println("pogresna lozinka!");

        vratiZapise = false;
        obrisiZapise = false;
        request->send(404, "text/plain", "Pogresna lozinka za resetiranje zapisa!");
    }
  });
 
  server.on("/addFinger", HTTP_POST, [](AsyncWebServerRequest *request){
    //upisivanje = 1;
    prekini_upisivanje = 1; //SAD GA STAVLJA NA KECA ZA SVAKI SLUCAJ A AKO BUDE IME I PREZIME UNESENO ONDA IDE NA NULU
    AsyncWebParameter* p = request->getParam(1);
    String ime = String(p->value());
    p = request->getParam(0);
    String prezime = String(p->value().c_str());
    
    ime.toLowerCase();
    prezime.toLowerCase();
    
    Serial.print("Generirano prezime i ime je :");
    Serial.print(prezime);
    Serial.print(", ");
    Serial.println(ime); 
    if (ime.length() > 1 && prezime.length() > 1){
      rc = openDb("/sd/bazaPodataka.db", &db1); //otvori.  
      prekini_upisivanje = 0; //SAD MOZE UPISAT
      //da probamo sa drugacijim nacinom query-anja:
      sqlQuery = ""; // ocisti prije upotrebe.          //dodao broj zadataka.
      sqlQuery += "INSERT INTO radnici (Prezime, Ime, Status, Sekunde, BrojZadataka) VALUES('";
      sqlQuery += prezime + "', '";
      sqlQuery += ime + "', 0, 0, 0);";
      Serial.println("generirana sql naredba je :");
      Serial.println(sqlQuery);
      rc = db_exec(db1, stringUpChar(sqlQuery));
      rc = db_exec(db1, "SELECT * FROM radnici WHERE id = (SELECT MAX(id) FROM radnici);");
      Serial.print("Enrolling ID #");
      Serial.println(db_row[0]);
      id = atoi(db_row[0].c_str());
      sqlite3_close(db1);
      request->redirect("/enroll");
    }
    //sqlite3_close(db1);
  });

  server.on("/enroll", HTTP_GET, [](AsyncWebServerRequest *request){
    //request->send(SPIFFS, "/enrol.html", "text/html");
    //i ovaj sam kodiro.
    AsyncWebServerResponse *response = request->beginResponse_P(200, "text/html", htmlEnroll, sizeof(htmlEnroll));
    response->addHeader("Content-Encoding", "gzip");
    request->send(response);
    delay(500);
 
    if (prekini_upisivanje == 0) {
        upisivanje = 1; //da bi u loop-u proradilo.
        Serial.println("evo posluzio sam enroll za otisak..");
    }
  });
  server.begin();
}

void enrollKopija() {
  while(!getFingerprintEnroll() && prekini_upisivanje == 0);
  Serial.println("PREKID");
}

void loop()                     // run over and over again
{
  if (upisivanje == 0){ //AKO SE TRENUTNO NE VRSI UPISIVANJE ONDA MOZE PROVJERAVATI IMA LI OTISKA NA ULAZU
    getFingerprintID();
    //getFingerprintIDez(); MISLIM DA MOZE OCITAVAT I BEZ OVE FUNKCIJE, MISLIM MENI SAD KAD SAM PROBO RADI
  } else if (upisivanje == 1 && posluzioEnroll) { //znaci da sam na enroll stranici
    upisivanje = 0;
    posluzioEnroll = false;  
    enrollKopija(); //tek sad enrollaj novog klijenta.  
    prekini_upisivanje = 1; // ne treba mi vise upisivat, resetiram varijablu.
    delay(3000); //delayaj da se ne pomijesa enrollanje sa ulaskom.
  }

  /*
  //naravno ova globalna mreza na koju se konektujemo bi trebala da ima pristup internetu.  
  if (WiFi.status() != WL_CONNECTED && diodaUpaljena) { // nisam konektovan a dioda upaljena.
    digitalWrite(diodaZaMrezu, LOW);
    diodaUpaljena = false;
  } else if (WiFi.status() == WL_CONNECTED && !diodaUpaljena) { //konektovan sam a dioda ugasena.
    digitalWrite(diodaZaMrezu, HIGH);
    diodaUpaljena = true;
  }
  */
  
  delay(50);            //don't ned to run this at full speed.
}
//////// Ovdje su sve funkcije koje su dodane 
void formirajSqlHistorija() {
    //samo kopirati kod od proslog queryja.
    
    sqlQuery = "";
    sqlQuery += "SELECT * FROM mjeseci WHERE ID ";

    if (r.id == -1)
        sqlQuery += "!= " + String(maxRadnika + 1);
    else
        sqlQuery += "= " + String(r.id);

    sqlQuery += " AND UPPER(Prezime) ";

    if (r.prezime == "")
       sqlQuery += "!= ''";
    else
       sqlQuery += "= UPPER('" + String(r.prezime) + "')";              

    sqlQuery += " AND UPPER(Ime) ";

    if (r.ime == "")    
        sqlQuery += "!= ''";   
    else
        sqlQuery += "= UPPER('" + String(r.ime) + "')";        
    
    sqlQuery += " AND Mjesec ";
    
    if (d.mjesec == 0) 
        sqlQuery += "> 0";
    else
        sqlQuery += "= " + String(d.mjesec);
    
    sqlQuery += " AND Godina ";
    
    if (d.godina == 0) 
        sqlQuery += "> 0";
    else
        sqlQuery += "= " + String(d.godina);
    

    sqlQuery += ";";               
}

void generirajUpitZapisi() {
    sqlQuery = "";
    sqlQuery += "SELECT * FROM zapisi WHERE ID ";

    if (r.id == -1)
        sqlQuery += "!= " + String(maxRadnika);
    else
        sqlQuery += "= " + String(r.id);

    sqlQuery += " AND UPPER(prezime) ";

    if (r.prezime == "")
       sqlQuery += "!= ''";
    else
       sqlQuery += "= UPPER('" + String(r.prezime) + "')";              

    sqlQuery += " AND UPPER(ime) ";

    if (r.ime == "")    
        sqlQuery += "!= ''";   
    else
        sqlQuery += "= UPPER('" + String(r.ime) + "')";

    sqlQuery += " AND dan ";
    
    if (d.dan == 0) 
        sqlQuery += "> 0";
    else
        sqlQuery += "= " + String(d.dan);
    
    sqlQuery += " AND mjesec ";
    
    if (d.mjesec == 0) 
        sqlQuery += "> 0";
    else
        sqlQuery += "= " + String(d.mjesec);
    
    sqlQuery += " AND godina ";
    
    if (d.godina == 0) 
        sqlQuery += "> 0";
    else
        sqlQuery += "= " + String(d.godina);
    

    sqlQuery += ";";               
}

void generirajUpitRadnici() {
    sqlQuery = "";
    sqlQuery += "SELECT * FROM radnici WHERE ID ";
    if (r.id == -1)
        sqlQuery += "!= " + String(maxRadnika); // trivijalan slucaj se ogleda u tome da se broj radnika krece od (0 - (maxRadnika - 1)), pa nikad nece moci biti maxRadnika.
    else
        sqlQuery += "= " + String(r.id);

    sqlQuery += " AND UPPER(Prezime) ";

    if (r.prezime == "") 
        sqlQuery += "!= ''";
    else
        sqlQuery += "= UPPER('" + String(r.prezime) + "')";       

    sqlQuery += " AND UPPER(Ime) ";

    if (r.ime == "") {
        sqlQuery += "!= ''";
    } else {
        sqlQuery += "= UPPER('" + String(r.ime) + "')";
    }
    sqlQuery += ";";                 
}

void generirajDatumIVrijeme() { 
    digitalWrite(diodaZaMrezu, LOW);
    while(!getLocalTime(&vrijemeDatum)) {
        Serial.println("Zapeo sam u 'generirajDatumIVrijeme'");
        delay(1000); //ako ti sve stane, znaci da nisi spojen sa internetom, te ova while sve zaustavi.
    }   
    digitalWrite(diodaZaMrezu, HIGH); //sve dobro proslo.
    d.dan = vrijemeDatum.tm_mday;
    d.mjesec = vrijemeDatum.tm_mon + 1;
    d.godina = vrijemeDatum.tm_year + 1900;
    v.sat = vrijemeDatum.tm_hour;
    v.minuta = vrijemeDatum.tm_min;
    return;
}

void resetujVremena() {        
    sqlQuery = "";
    sqlQuery += "UPDATE radnici SET Sekunde = 0, BrojZadataka = 0;";    
    rc = db_exec(db1, stringUpChar(sqlQuery));
}

char* stringUpChar(String mojString) {
    if (mojString.length() != 0) {
        char *p = const_cast<char*>(mojString.c_str());
        return p;
    }
    return NULL;
}

String formirajDatum(int mjesec, int godina) {
    String r = "";
    switch (mjesec) {
        case 1: r = "January";
        break;
        case 2: r = "February";
        break;
        case 3: r = "March";
        break;
        case 4: r = "April";
        break;
        case 5: r = "May";
        break;
        case 6: r = "June";
        break;
        case 7: r = "July";
        break;
        case 8: r = "August";
        break;
        case 9: r = "September";
        break;
        case 10: r = "October";
        break;
        case 11: r = "November";
        break;
        case 12: r = "December";
        break;
        default: r = "Error Converting...";
        break;               
    }

    r += " " + String(godina);
    return r;
}

void resetujZapise() {
    sqlQuery = "";
    sqlQuery += "DELETE FROM zapisi;";
    db_exec(db1, stringUpChar(sqlQuery));

    sqlQuery = "";
    sqlQuery += "UPDATE radnici SET Status = 0;";
    db_exec(db1, stringUpChar(sqlQuery));
    return;
}

////////

uint8_t getFingerprintID() {
  uint8_t p = finger.getImage();
  switch (p) {
    case FINGERPRINT_OK:
      break;
    case FINGERPRINT_NOFINGER:
      return p;
    case FINGERPRINT_PACKETRECIEVEERR:
      return p;
    case FINGERPRINT_IMAGEFAIL:
      return p;
    default:
      return p;
  }
  p = finger.image2Tz();
  switch (p) {
    case FINGERPRINT_OK:
      break;
    case FINGERPRINT_IMAGEMESS:
      return p;
    case FINGERPRINT_PACKETRECIEVEERR:
      return p;
    case FINGERPRINT_FEATUREFAIL:
      return p;
    case FINGERPRINT_INVALIDIMAGE:
      return p;
    default:
      return p;
  }
 
  p = finger.fingerFastSearch();
  if (p == FINGERPRINT_OK) {
    Serial.println("Found a print match!");
  } else if (p == FINGERPRINT_PACKETRECIEVEERR) {
    Serial.println("Communication error");
    return p;
  } else if (p == FINGERPRINT_NOTFOUND) {
    Serial.println("Did not find a match");
    return p;
  } else {
    Serial.println("Unknown error");
    return p;
  }   
  digitalWrite(diodaZaUlazak, HIGH);
  delay(2000); // neka se zna da je sve dobro proslo.
  digitalWrite(diodaZaUlazak, LOW);
  Serial.print("Found ID #"); Serial.print(finger.fingerID);
  Serial.print(" with confidence of "); Serial.println(finger.confidence); 
  //pamcenje ulaska u tabelu 'zapisi' i eventualno mijenjanje zbroja vremena.
  rc = openDb("/sd/bazaPodataka.db", &db1); //otvori.
    
  r.id = finger.fingerID; 
  
  generirajDatumIVrijeme(); 

  //na osnovu ID-ja, povuci informacije o radniku iz tabele radnici:
  Serial.println("evo me vratio sam se zivote...");    
  sqlQuery = "";
  sqlQuery += "SELECT * FROM radnici WHERE ID = " + String(r.id) + ";";
  Serial.print("generirana naredba: ");Serial.println(sqlQuery);//debug svrhe.
    
  rc = sqlite3_prepare_v2(db1, sqlQuery.c_str(), 1000, &res, &tail);
  if (rc == SQLITE_OK) {
    //0-ID i 4-sekunde nam ne trebaju sad.
    if (sqlite3_step(res) == SQLITE_ROW) { //0-indeksirano
        r.prezime = (const char *)(sqlite3_column_text(res, 1));
        r.ime = (const char *)(sqlite3_column_text(res, 2));
        r.aktivnost = sqlite3_column_int(res, 3);
    }
  }
  rc = sqlite3_reset(res); 
  sqlite3_finalize(res);

  if (r.aktivnost == 0) { //zapocinje sa zadatkom, nista ne update-ovati.
     //promijeni stanje u aktivan:
     sqlQuery = "";
     sqlQuery += "UPDATE radnici SET Status = 1 WHERE ID = " + String(r.id) + ";";  
     Serial.print("generirana sql naredba je :");
     Serial.println(sqlQuery); //debug.
        
     db_exec(db1, stringUpChar(sqlQuery));

     //insertaj u tabelu 'zapisi' novi log:
          
     sqlQuery = "";
     sqlQuery += "INSERT INTO zapisi VALUES (";
     sqlQuery += String(r.id) + ", '";
     sqlQuery += r.prezime + "', '";
     sqlQuery += r.ime + "', ";
     sqlQuery += String(d.dan) + ", " + String(d.mjesec) + ", " + String(d.godina) + ", '"; // ovdje ako bude nesto da ne valja provjeri kako su napisani, eto dole sam ja ispisivo poslje svake naredbe, samo provjeri.
     sqlQuery += String(v.sat) + ":" + String(v.minuta) + "', '-----', '-----');";     

     Serial.print("generirana sql naredba je :");
     Serial.println(sqlQuery); //debugging.
     db_exec(db1, stringUpChar(sqlQuery));
     
  } else { //zavrsio sa zadatkom, povecaj broj uradjenih zadataka.
     //ako je aktivan, prvo mu takodjer promijeni stanje u tabeli 'radnici':
     sqlQuery = "";
     //ovo je za pracenje aktivnosti, te da vidimo "ukupni" broj zadataka, te ukupno provedeno vremena u sistemu.
     //nema veze sto se resetuju zapisi i ukupna vremena i zadaci, imamo informacije u tabeli zvanoj 'mjeseci'.
     sqlQuery += "UPDATE radnici SET Status = 0, BrojZadataka = BrojZadataka + 1 WHERE ID = " + String(r.id) + ";";  

     Serial.print("generirana sql naredba je :");
     Serial.println(sqlQuery); // debug.
     db_exec(db1, stringUpChar(sqlQuery));

     //structovi za oduzimanje vremena:
     tmElements_t t1;
     tmElements_t t2;
     String mojeVrijeme = "";

     //oduzimamo vec zapamceno vrijeme od ovoga sad.
     t2.Day = d.dan;
     t2.Year = d.godina - 1970;
     t2.Month = d.mjesec;
     t2.Hour = v.sat;
     t2.Minute = v.minuta;
     t2.Second = 0;

     //vrati vrijeme ulaska jedinke iz tabele 'zapisi':
     //ovo je ono sto smo govorili, postoji samo jedna osoba ciji je id = ID i 
     //koja je u skladistu:
     //drugim rijecima, jedna osoba u ovom trenutku moze samo jednom biti u skladistu, ne moze dva puta.

     //update-aj vrijeme radnika:
     sqlQuery = "";
     sqlQuery += "SELECT * FROM zapisi WHERE ID = ";
     sqlQuery += String(r.id) + " AND datumOdlaska = '-----' AND vrijemeOdlaska = '-----';";     

     rc = sqlite3_prepare_v2(db1, sqlQuery.c_str(), 1000, &res, &tail);   
     if (rc == SQLITE_OK) {
        if (sqlite3_step(res) == SQLITE_ROW) {
            //0-id, 1-prezime, 2-ime - ne treba mi.
            Serial.println("dobro je ");
            t1.Day = sqlite3_column_int(res, 3);
            t1.Month = sqlite3_column_int(res, 4);
            t1.Year = sqlite3_column_int(res, 5) - 1970;                         
            t1.Second = 0;            
            mojeVrijeme = (const char *)(sqlite3_column_text(res, 6));     
        } else {
            Serial.println("pogreska kod sqlite3_step.");
        }
     }
     //ako sta ne bude uredu, isto provjeriti i te gore dobivene vrijednosti
     rc = sqlite3_reset(res);
     sqlite3_finalize(res);
     
     //konverzija stringa o vremenu u integere:
     t1.Hour = (mojeVrijeme.substring(0, mojeVrijeme.indexOf(":", 0))).toInt();
     t1.Minute = (mojeVrijeme.substring(mojeVrijeme.indexOf(":", 0) + 1, mojeVrijeme.length())).toInt();    

     Serial.println("vrijeme u obliku sati:minute je :"); //takodjer debug.
     Serial.print(t1.Hour);Serial.print(":");Serial.println(t1.Minute);
     
     uint32_t razlika = makeTime(t2) - makeTime(t1);
     ///maaaalo bolji nacin:     
     uint32_t t1Sekunde = (t1.Hour * 3600 + t1.Minute * 60);
     uint32_t t2Sekunde = (t2.Hour * 3600 + t2.Minute * 60);
     uint32_t razlika2 = t2Sekunde - t1Sekunde; 
       
     Serial.print("ovo je razlika u sekundama :");
     Serial.println(razlika);

     sqlQuery = "";
     sqlQuery += "UPDATE radnici SET Sekunde = Sekunde + ";
     sqlQuery += String(razlika2) + " WHERE ID = ";
     sqlQuery += String(r.id) + ";";

     db_exec(db1, stringUpChar(sqlQuery));

     Serial.print("generirani sql statement je :");
     Serial.println(sqlQuery); 

    //zamislimo da imamo tabelu sa sljedecim kolonama : ID|Prezime|Ime|Mjesec|Godina|Sekunde|BrojZadataka.
    //prvo treba povecati broj zadataka, a zatim i vrijeme, napraviti novi zapis samo ukoliko
    //vec ne postoji (to raditi sa IGNORE OR), gdje je unique key: ID, Prezime, Ime, Mjesec, Godina.
    ///insertaj prvi datum.
    sqlQuery = "";
    
    sqlQuery += "INSERT OR IGNORE INTO mjeseci (ID, Prezime, Ime, Mjesec, Godina, Sekunde, BrojZadataka) VALUES (";            
    sqlQuery += String(r.id) + ", '" + String(r.prezime) + "', '" + String(r.ime) + "', " + String(t1.Month) + ", " + String(t1.Year + 1970) + ", 0, 0);";

    Serial.println("generirani sql statement je :");
    Serial.println(sqlQuery);
    db_exec(db1, stringUpChar(sqlQuery));
    
    //ako su datumi različiti, insertaj i drugi.
    sqlQuery = "";
    
    sqlQuery += "INSERT OR IGNORE INTO mjeseci (ID, Prezime, Ime, Mjesec, Godina, Sekunde, BrojZadataka) VALUES (";            
    sqlQuery += String(r.id) + ", '" + String(r.prezime) + "', '" + String(r.ime) + "', " + String(t2.Month) + ", " + String(t2.Year + 1970) + ", 0, 0);";

    Serial.println("generirani sql statement je :");
    Serial.println(sqlQuery);
    db_exec(db1, stringUpChar(sqlQuery));
    
    //provjeri da li su datumi isti:
    if (t1.Month == t2.Month){ //ako su isti, treba update-ovati samo jedan datum.
        sqlQuery = "";
        sqlQuery += "UPDATE mjeseci SET Sekunde = Sekunde + " + String(razlika2) + ", BrojZadataka = BrojZadataka + 1 WHERE ID = " + String(r.id) + " AND Mjesec = " + String(d.mjesec) + " AND Godina = " + String(d.godina) + ";";       
        Serial.println("generirani sql statement je :");
        Serial.println(sqlQuery);
        db_exec(db1, stringUpChar(sqlQuery));        
    }else if (t1.Month != t2.Month) { //ako su različiti, treba updateovati obadva mjeseca.
        sqlQuery = "";
        sqlQuery += "UPDATE mjeseci SET Sekunde = Sekunde + " + String((24 * 3600 - t1Sekunde)) + ", BrojZadataka = BrojZadataka + 1 WHERE ID = " + String(r.id) + " AND Mjesec = " + String(t1.Month) + " AND Godina = " + String(t1.Year + 1970) + ";";
        Serial.println("generirani sql statement je :");
        Serial.println(sqlQuery);
        db_exec(db1, stringUpChar(sqlQuery));

        //sada updateovati i drugi:
        sqlQuery = "";
        sqlQuery += "UPDATE mjeseci SET Sekunde = Sekunde + " + String(t2Sekunde) + ", BrojZadataka = BrojZadataka + 1 WHERE ID = " + String(r.id) + " AND Mjesec = " + String(t2.Month) + " AND Godina = " + String(t2.Year + 1970) + ";";                      
        Serial.println("drugi sql statement koji je formiran je :");
        Serial.println(sqlQuery);
        db_exec(db1, stringUpChar(sqlQuery));
    }      
     
     //sada update-aj zapis u tabeli 'zapisi'
     sqlQuery = "";
     sqlQuery += "UPDATE zapisi SET datumOdlaska = '";
     sqlQuery += String(d.dan) + "." + String(d.mjesec) + "." + String(d.godina) + "', vrijemeOdlaska = '";
     sqlQuery += String(v.sat) + ":" + String(v.minuta) + "' WHERE ID = ";
     sqlQuery += String(r.id) + " AND datumOdlaska = '-----' AND vrijemeOdlaska = '-----';";      

     Serial.print("generirani sql je :");
     Serial.println(sqlQuery);
     
     db_exec(db1, stringUpChar(sqlQuery));
        
  }

  sqlite3_close(db1);   
  return finger.fingerID;
}

// returns -1 if failed, otherwise returns ID #
int getFingerprintIDez() {
  uint8_t p = finger.getImage();
  if (p != FINGERPRINT_OK)  return -1;

  p = finger.image2Tz();
  if (p != FINGERPRINT_OK)  return -1;

  p = finger.fingerFastSearch();
  if (p != FINGERPRINT_OK)  return -1;
  
  // found a match!
  Serial.print("Found ID #"); Serial.print(finger.fingerID); 
  Serial.print(" with confidence of "); Serial.println(finger.confidence);

  //pamcenje radnika u 'zapisi' i eventualno update-ovanje ukupnih vremena  
  
  return finger.fingerID; 
}
uint8_t getFingerprintEnroll() {
  if (globalClient == NULL) { // ne treba sad, al za svaki slucaj.
    return 10; //return bilo sta osim 0
  }
  delay(500);
  Serial.println("Running on core: ");
  Serial.println(xPortGetCoreID());
  int p = -1;
  Serial.print("Waiting for valid finger to enroll as #"); Serial.println(id);
  String msg = "Waiting for valid finger to enroll as #";
  msg += String(id);
  globalClient->text(msg);
  while (p != FINGERPRINT_OK) {
    p = finger.getImage();
    switch (p) {
    case FINGERPRINT_OK:
      Serial.println("Image taken");
      globalClient->text("Image taken");
      break;
    case FINGERPRINT_NOFINGER:
      Serial.println(".");
      break;
    case FINGERPRINT_PACKETRECIEVEERR:
      Serial.println("Communication error");
      break;
    case FINGERPRINT_IMAGEFAIL:
      Serial.println("Imaging error");
      break;
    default:
      Serial.println("Unknown error");
      break;
    }
  }

  // OK success!

  p = finger.image2Tz(1);
  switch (p) {
    case FINGERPRINT_OK:
      Serial.println("Image converted");
      break;
    case FINGERPRINT_IMAGEMESS:
      Serial.println("Image too messy");
      return p;
    case FINGERPRINT_PACKETRECIEVEERR:
      Serial.println("Communication error");
      return p;
    case FINGERPRINT_FEATUREFAIL:
      Serial.println("Could not find fingerprint features");
      return p;
    case FINGERPRINT_INVALIDIMAGE:
      Serial.println("Could not find fingerprint features");
      return p;
    default:
      Serial.println("Unknown error");
      return p;
  }
  globalClient->text("Remove finger");
  Serial.println("Remove finger");
  delay(2000);
  p = 0;
  while (p != FINGERPRINT_NOFINGER) {
    p = finger.getImage();
  }
  Serial.print("ID "); Serial.println(id);
  p = -1;
  globalClient->text("Place same finger again");
  Serial.println("Place same finger again");
  while (p != FINGERPRINT_OK) {
    p = finger.getImage();
    switch (p) {
    case FINGERPRINT_OK:
      Serial.println("Image taken");
      break;
    case FINGERPRINT_NOFINGER:
      Serial.print(".");
      break;
    case FINGERPRINT_PACKETRECIEVEERR:
      Serial.println("Communication error");
      break;
    case FINGERPRINT_IMAGEFAIL:
      Serial.println("Imaging error");
      break;
    default:
      Serial.println("Unknown error");
      break;
    }
  }

  // OK success!

  p = finger.image2Tz(2);
  switch (p) {
    case FINGERPRINT_OK:
      Serial.println("Image converted");
      break;
    case FINGERPRINT_IMAGEMESS:
      Serial.println("Image too messy");
      return p;
    case FINGERPRINT_PACKETRECIEVEERR:
      Serial.println("Communication error");
      return p;
    case FINGERPRINT_FEATUREFAIL:
      Serial.println("Could not find fingerprint features");
      return p;
    case FINGERPRINT_INVALIDIMAGE:
      Serial.println("Could not find fingerprint features");
      return p;
    default:
      Serial.println("Unknown error");
      return p;
  }
  
  // OK converted!
  Serial.print("Creating model for #");  Serial.println(id);
  
  p = finger.createModel();
  if (p == FINGERPRINT_OK) {
    Serial.println("Prints matched!");
  } else {
        if (p == FINGERPRINT_PACKETRECIEVEERR) {
            Serial.println("Communication error");
            globalClient->text("Communication error");            
       } else if (p == FINGERPRINT_ENROLLMISMATCH) {
            Serial.println("Fingerprints did not match");
            globalClient->text("Fingerprints did not match");            
       } else {
            Serial.println("Unknown error");
            globalClient->text("Unknown error");
       }
       delay(2000);
       globalClient->text("Trying again");
       for (int i = 0;i < 5; i++) {
            globalClient->text(".");
            delay(1000);
       }
       delay(1000);       
       return 0;
  }
  Serial.print("ID "); Serial.println(id);
  p = finger.storeModel(id);
  if (p == FINGERPRINT_OK) {
    globalClient->text("Stored");
    delay(1000);
    globalClient->text("Redirecting");
    for (int i = 0; i < 5; i++) {
        globalClient->text(".");
        delay(1000);
    }
    Serial.println("Stored!");
    globalClient->text("redirect");
    return 1;
  } else if (p == FINGERPRINT_PACKETRECIEVEERR) {
    globalClient->text("Communication error");
    Serial.println("Communication error");
    return p;
  } else if (p == FINGERPRINT_BADLOCATION) {
    globalClient->text("Could not store in that location");
    Serial.println("Could not store in that location");
    return p;
  } else if (p == FINGERPRINT_FLASHERR) {
    globalClient->text("Error writing to flash");
    Serial.println("Error writing to flash");
    return p;
  } else {
    Serial.println("Unknown error");
    return p;
  }   
}

//pogledaj dolje, u ws_event_handleru ima promjena!
static int callback(void *data, int argc, char **argv, char **azColName){
   int i;
   Serial.printf("%s: ", (const char*)data);
   Serial.println("CALLBACK FUNCTION CALLED");
   for (i = 0; i<argc; i++){
       Serial.printf("%s = %s\n", azColName[i], argv[i] ? argv[i] : "NULL");
       db_row[i] = argv[i];
   }
   Serial.printf("\n");
   return 0;
}

int openDb(const char *filename, sqlite3 **db) {
   int rc = sqlite3_open(filename, db);
   if (rc) {
       Serial.printf("Can't open database: %s\n", sqlite3_errmsg(*db));
       return rc;
   } else {
       Serial.printf("Opened database successfully\n");
   }
   return rc;
}

char *zErrMsg = 0;
int db_exec(sqlite3 *db, const char *sql) {
   Serial.println(sql);
   long start = micros();
   int rc = sqlite3_exec(db, sql, callback, (void*)data, &zErrMsg);
   if (rc != SQLITE_OK) {
       Serial.printf("SQL error: %s\n", zErrMsg);
       sqlite3_free(zErrMsg);
   } else {
       Serial.printf("Operation done successfully\n");
   }
   Serial.print(F("Time taken:"));
   Serial.println(micros()-start);
   return rc;
}

void onWsEvent(AsyncWebSocket * server, AsyncWebSocketClient * client, AwsEventType type, void * arg, uint8_t *data, size_t len){
  double ukupnoSekundi = 0.00;    
  int brojZadataka = 0;  
  if(type == WS_EVT_CONNECT){
    Serial.println("Konekcija sa klijentom ostvarena.");
    if (upisivanje == 1) {
        posluzioEnroll = true;
        globalClient = client; //znam da mi je enroll.
    } else if (vratiNajefikasnije) { // to znaci da trebam da vratim najefikasnije.
        vratiNajefikasnije = false; // resetiraj varijablu za primjecivanje promjene.

        rc = openDb("/sd/bazaPodataka.db", &db1); //otvori.
        
        sqlQuery = "";
        sqlQuery += "SELECT * FROM mjeseci WHERE Sekunde != 0 AND BrojZadataka != 0 AND ((Sekunde/3600)/BrojZadataka) <= " + String(satiPoZadatku) + " AND ";
        if (r.id == -1)
            sqlQuery += "ID != " + String(maxRadnika) + " AND ";
        else
            sqlQuery += "ID = " + String(r.id) + " AND ";

        if (r.prezime == "")
            sqlQuery += "Prezime != '' AND ";
        else
            sqlQuery += "UPPER(Prezime) = UPPER('" + String(r.prezime) + "') AND ";                                            

        if (r.ime == "")
            sqlQuery += "Ime != '' AND ";
        else
            sqlQuery += "UPPER(Ime) = UPPER('" + String(r.ime) + "') AND ";

        sqlQuery += "Godina = " + String(d.godina) + " AND Mjesec = " + String(d.mjesec) + ";";                
        
        Serial.println("generirana sql naredba je :");
        Serial.println(sqlQuery); //for debugging purposes.
        String p = "";        
        rc = sqlite3_prepare_v2(db1, sqlQuery.c_str(), 1000, &res, &tail);  

        if (rc != SQLITE_OK) {
            Serial.println("greska prilikom pripremanja vrijednosti.");
        } else {            
            double efikasn = 0.00;
            while(sqlite3_step(res) == SQLITE_ROW) { // salji klijentu vrijednosti.
                p = "";
                p += String(sqlite3_column_int(res, 0)) + "|" + (const char *)(sqlite3_column_text(res, 1)) + "|" + (const char *)(sqlite3_column_text(res, 2)) + "|";
                ukupnoSekundi = sqlite3_column_double(res, 5);
                brojZadataka = sqlite3_column_int(res, 6);
                
                if (brojZadataka == 0)
                    efikasn = 10000.00;
                else
                    efikasn = (ukupnoSekundi/3600)/brojZadataka;
                    
                p += String(efikasn, 2);
                client->text(p);
                Serial.println("Ovo je generirani sql statement:");
                Serial.println(p);
            }
            
        }
        rc = sqlite3_reset(res);
        sqlite3_finalize(res);

        sqlite3_close(db1);
    } else if (vratiHistoriju) { // vracam historiju efikasnosti.
        vratiHistoriju = false;

        //napraviti sql i tabelu u bazi podataka.            
        //ime tabele: historija.
        //ime kolona:ID, Prezime, Ime, Mjesec, Godina, Sekunde, BrojZadataka - nova tabela - mjeseci..
        formirajSqlHistorija(); // formiram sql.

        rc = openDb("/sd/bazaPodataka.db", &db1); //otvori.

        rc = sqlite3_prepare_v2(db1, sqlQuery.c_str(), 1000, &res, &tail);  

        if (rc != SQLITE_OK) {
            Serial.println("nesto nije u redu...");
        } else {
            String a = "";
            double efikasn = 0.000;
            while (sqlite3_step(res) == SQLITE_ROW) {
                a = "";
                a += String(sqlite3_column_int(res, 0)) + "|" + (const char *)(sqlite3_column_text(res, 1)) + "|" + (const char *)(sqlite3_column_text(res, 2)) + "|";
                d.mjesec = sqlite3_column_int(res, 3);
                d.godina = sqlite3_column_int(res, 4);
                ukupnoSekundi = sqlite3_column_double(res, 5);
                brojZadataka = sqlite3_column_int(res, 6);
                
                if (brojZadataka == 0)
                    efikasn = 0.00;
                else
                    efikasn = (ukupnoSekundi/3600)/brojZadataka;
                    
                a += formirajDatum(d.mjesec, d.godina) + "|" + String(efikasn, 2);
                client->text(a);
                Serial.println("ovo je generirana poruka:");
                Serial.println(a);
            }
        }

        rc = sqlite3_reset(res);
        sqlite3_finalize(res);

        sqlite3_close(db1);
    }
  } else if(type == WS_EVT_DISCONNECT){
    Serial.println("Konekcija sa klijentom izgubljena.");
    globalClient = NULL;

  } else if (type == WS_EVT_DATA) {
    //ako sam primio informacije od različitih stranica, raspitaj se koja je koja:
    String poruka = "";
    String odgovor = "";
    for (int i = 0; i < len; i++) 
        poruka = poruka + (char)data[i];

    Serial.print("primljena poruka je :");
    Serial.println(poruka);

    rc = openDb("/sd/bazaPodataka.db", &db1); //otvori.
    
    if (poruka == "zapisi" && vratiZapise == true) {
        vratiZapise = false;

        generirajUpitZapisi();

        Serial.print("ovo je generirana sql naredba: ");
        Serial.println(sqlQuery);

        rc = sqlite3_prepare_v2(db1, sqlQuery.c_str(), 1000, &res, &tail);                      

        if (rc != SQLITE_OK) {
            Serial.println("nisam uspio pripremiti povratne informacije");                           
        } else {
            while(sqlite3_step(res) == SQLITE_ROW) {
                odgovor = "";
                odgovor += String(sqlite3_column_int(res, 0)) + "|" + (const char *)(sqlite3_column_text(res, 1)) + "|" + (const char *)(sqlite3_column_text(res, 2)) + "|";
                odgovor += String(sqlite3_column_int(res, 3)) + "." + String(sqlite3_column_int(res, 4)) + "." + String(sqlite3_column_int(res, 5)) + "|" + (const char *)(sqlite3_column_text(res, 6)) + "|" + (const char *)(sqlite3_column_text(res, 7)) + "|" + (const char*)(sqlite3_column_text(res, 8));
                client->text(odgovor);    
                Serial.println("poslani upit je :");
                Serial.println(odgovor);
            }
        }
        rc = sqlite3_reset(res);
        sqlite3_finalize(res);
    } else if (obrisiZapise == true && poruka == "zapisi") {
        obrisiZapise = false;
        resetujZapise();
        client->text("obrisani zapisi"); // ako ne moze ovo, onda probaj "obrisani zapisi" da posaljes.
    } else if (vratiKorisnike == true && poruka == "korisnici") {
        vratiKorisnike = false;

        generirajUpitRadnici();

        Serial.println("generirani query u 'korisnici' je : ");
        Serial.println(sqlQuery);

        rc = sqlite3_prepare_v2(db1, sqlQuery.c_str(), 1000, &res, &tail);

        if (rc != SQLITE_OK) {
            Serial.println("nisam upsio pripremiti povratnu vrijednost");
        } else {
            while (sqlite3_step(res) == SQLITE_ROW) {
                odgovor = "";
                odgovor += String(sqlite3_column_int(res, 0)) + "|" + (const char *)(sqlite3_column_text(res, 1)) + "|" + (const char *)(sqlite3_column_text(res, 2)) + "|";   
                byte a = sqlite3_column_int(res, 3);
                uint64_t vremeSekunde = sqlite3_column_double(res, 4);
                uint32_t brojZad = sqlite3_column_int(res, 5);
                String aktivan = "";
                if (a == 1) {
                    aktivan = "Still working on task";
                } else {
                    aktivan = "Task Finished";
                }
                               
                uint32_t sahati = (vremeSekunde / 3600);
                vremeSekunde = vremeSekunde % 3600;
                uint32_t minutee = vremeSekunde / 60;
                uint32_t s = vremeSekunde % 60;

                String vri = String(sahati) + ":" + String(minutee) + ":" + String(s);

                odgovor += aktivan + "|" + vri + "|" + String(brojZad);

                client->text(odgovor);

                Serial.println("poslani upit je :");
                Serial.println(odgovor);
                odgovor = "";
            }
        }
        rc = sqlite3_reset(res);
        sqlite3_finalize(res);
    } else if (obrisiVremena == true && poruka == "korisnici") {
        obrisiVremena = false;
        resetujVremena();
        Serial.println("vremena korisnika resetirana");
        client->text("obrisana vremena");
    }

    sqlite3_close(db1);    
  }
}
